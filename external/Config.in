## external/configs/ipodos_x86_64_defconfig
```kconfig
BR2_x86_64=y
BR2_TOOLCHAIN_BUILDROOT_GLIBC=y

# System
BR2_SYSTEM_HOSTNAME="ipodos"
BR2_INIT_SYSTEMD=y
BR2_TARGET_GENERIC_GETTY_PORT="tty1"

# Pakete (Netzwerk & Audio)
BR2_PACKAGE_SYSTEMD=y
BR2_PACKAGE_SYSTEMD_NETWORKD=y
BR2_PACKAGE_SYSTEMD_RESOLVED=y
BR2_PACKAGE_OPENSSH=y
BR2_PACKAGE_OPENSSH_SERVER=y
BR2_PACKAGE_ALSA_UTILS=y

# Grafik (Wayland & Cage)
BR2_PACKAGE_WAYLAND=y
BR2_PACKAGE_CAGE=y

# Achtung: Chromium braucht SEHR lange zum Bauen (4h+). 
# Zum Testen besser erst mal auskommentiert lassen:
# BR2_PACKAGE_CHROMIUM=y

# Dateisystem & Overlay
BR2_ROOTFS_OVERLAY="$(BR2_EXTERNAL_IPOD_PATH)/rootfs-overlay"
BR2_TARGET_ROOTFS_EXT2=y
BR2_TARGET_ROOTFS_EXT2_4=y

# Bootloader (Korrigiert für aktuelle Buildroot-Versionen)
BR2_TARGET_GRUB2=y
BR2_TARGET_GRUB2_I386_PC=y
BR2_TARGET_GRUB2_BUILTIN_MODULES="part_gpt part_msdos ext2 normal linux"

# ISO Image Erstellung
BR2_TARGET_ROOTFS_ISO9660=y
BR2_TARGET_ROOTFS_ISO9660_BOOT_MENU_LABEL="iPodOS"
```
